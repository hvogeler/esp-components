## bmp280/Kconfig
```kconfig
menu "BMP280 Configuration"

    config BMP280_I2C_ADDRESS
        hex "I2C Address"
        default 0x76
        range 0x76 0x77
        help
            I2C address of the BMP280/BME280 sensor.
            0x76 when SDO pin is connected to GND.
            0x77 when SDO pin is connected to VCC.

    config BMP280_I2C_CLOCK_SPEED_HZ
        int "I2C Clock Speed (Hz)"
        default 100000
        range 100000 400000
        help
            I2C clock speed in Hz.
            100000 (100kHz) - Standard mode, more reliable.
            400000 (400kHz) - Fast mode, higher throughput.

    choice BMP280_TEMP_OVERSAMPLING
        prompt "Temperature Oversampling"
        default BMP280_TEMP_OVERSAMPLING_X2
        help
            Temperature measurement oversampling setting.
            Higher values increase accuracy but also measurement time.

        config BMP280_TEMP_OVERSAMPLING_SKIP
            bool "Skipped (output set to 0x80000)"
        config BMP280_TEMP_OVERSAMPLING_X1
            bool "x1"
        config BMP280_TEMP_OVERSAMPLING_X2
            bool "x2"
        config BMP280_TEMP_OVERSAMPLING_X4
            bool "x4"
        config BMP280_TEMP_OVERSAMPLING_X8
            bool "x8"
        config BMP280_TEMP_OVERSAMPLING_X16
            bool "x16"
    endchoice

    config BMP280_TEMP_OVERSAMPLING
        int
        default 0 if BMP280_TEMP_OVERSAMPLING_SKIP
        default 1 if BMP280_TEMP_OVERSAMPLING_X1
        default 2 if BMP280_TEMP_OVERSAMPLING_X2
        default 3 if BMP280_TEMP_OVERSAMPLING_X4
        default 4 if BMP280_TEMP_OVERSAMPLING_X8
        default 5 if BMP280_TEMP_OVERSAMPLING_X16

    choice BMP280_PRESS_OVERSAMPLING
        prompt "Pressure Oversampling"
        default BMP280_PRESS_OVERSAMPLING_X16
        help
            Pressure measurement oversampling setting.
            Higher values increase accuracy but also measurement time.

        config BMP280_PRESS_OVERSAMPLING_SKIP
            bool "Skipped (output set to 0x80000)"
        config BMP280_PRESS_OVERSAMPLING_X1
            bool "x1"
        config BMP280_PRESS_OVERSAMPLING_X2
            bool "x2"
        config BMP280_PRESS_OVERSAMPLING_X4
            bool "x4"
        config BMP280_PRESS_OVERSAMPLING_X8
            bool "x8"
        config BMP280_PRESS_OVERSAMPLING_X16
            bool "x16"
    endchoice

    config BMP280_PRESS_OVERSAMPLING
        int
        default 0 if BMP280_PRESS_OVERSAMPLING_SKIP
        default 1 if BMP280_PRESS_OVERSAMPLING_X1
        default 2 if BMP280_PRESS_OVERSAMPLING_X2
        default 3 if BMP280_PRESS_OVERSAMPLING_X4
        default 4 if BMP280_PRESS_OVERSAMPLING_X8
        default 5 if BMP280_PRESS_OVERSAMPLING_X16

    choice BMP280_IIR_FILTER
        prompt "IIR Filter Coefficient"
        default BMP280_IIR_FILTER_OFF
        help
            IIR filter coefficient for reducing noise in measurements.
            Higher values provide more filtering but slower response.

        config BMP280_IIR_FILTER_OFF
            bool "Off"
        config BMP280_IIR_FILTER_2
            bool "2"
        config BMP280_IIR_FILTER_4
            bool "4"
        config BMP280_IIR_FILTER_8
            bool "8"
        config BMP280_IIR_FILTER_16
            bool "16"
    endchoice

    config BMP280_IIR_FILTER
        int
        default 0 if BMP280_IIR_FILTER_OFF
        default 1 if BMP280_IIR_FILTER_2
        default 2 if BMP280_IIR_FILTER_4
        default 3 if BMP280_IIR_FILTER_8
        default 4 if BMP280_IIR_FILTER_16

endmenu
```

## i2c/Kconfig
```kconfig
menu "I2C Configuration"

    config HV_I2C_SCL_GPIO
        int "SCL GPIO Pin"
        default 4
        range 0 48
        help
            GPIO pin number for I2C SCL (clock) line.

    config HV_I2C_SDA_GPIO
        int "SDA GPIO Pin"
        default 3
        range 0 48
        help
            GPIO pin number for I2C SDA (data) line.

    config HV_I2C_PROBE_ADDRESS
        hex "I2C Probe Address (0 to disable)"
        default 0x00
        range 0x00 0x7F
        help
            I2C device address to probe during initialization.
            Set to 0x00 to disable the probe check.
            Common addresses: 0x20-0x27 for MCP23017.

endmenu
```

## mcp23017/Kconfig
```kconfig
menu "MCP23017 Configuration"

    config HV_MCP23017_I2C_ADDRESS
        hex "I2C Address"
        default 0x20
        range 0x20 0x27
        help
            I2C address of the MCP23017 device.
            Valid range is 0x20-0x27 depending on A0-A2 pin configuration.

    config HV_MCP23017_I2C_CLOCK_FREQ
        int "I2C Clock Frequency (Hz)"
        default 100000
        range 10000 400000
        help
            I2C clock frequency in Hz.
            Standard mode: 100000 Hz
            Fast mode: 400000 Hz

    config HV_MCP23017_RESET_GPIO
        int "Reset GPIO Pin"
        default 6
        range 0 48
        help
            GPIO pin connected to the MCP23017 reset pin.

endmenu
```

## wifi/Kconfig
```kconfig
menu "WiFi Configuration"

    config HV_WIFI_TIMEZONE
        string "Timezone"
        default "CET-1CEST,M3.5.0,M10.5.0/3"
        help
            POSIX timezone string for time synchronization

    config HV_WIFI_TIME_SERVER_0
        string "Primary NTP Server"
        default "0.de.pool.ntp.org"
        help
            Primary NTP time server

    config HV_WIFI_TIME_SERVER_1
        string "Secondary NTP Server"
        default "1.de.pool.ntp.org"
        help
            Secondary NTP time server

    config HV_WIFI_MAX_RETRY
        int "Maximum connection retries"
        default 5
        range 1 20
        help
            Maximum number of WiFi connection retry attempts

endmenu
```
